## main/Kconfig.projbuild
```kconfig
menu "Welder Pulse Control Configuration"

    config WELDER_MAX_VOLTAGE
        int "Maximum Output Voltage (V)"
        default 15
        help
            Maximum voltage output range for welder control

    config WELDER_MAX_FREQUENCY
        int "Maximum Pulse Frequency (Hz x10)"
        default 100
        help
            Maximum pulse frequency in Hz (stored as x10)
            Default 100 = 10 Hz

    config WELDER_POTENTIOMETER_PIN
        int "Potentiometer ADC Pin"
        default 35
        help
            GPIO pin connected to the 5kΩ potentiometer

    config WELDER_DAC_PIN
        int "DAC Output Pin"
        default 17
        help
            GPIO pin for DAC voltage output

    config WELDER_PWM_PIN
        int "PWM Output Pin"
        default 1
        help
            GPIO pin for PWM pulse control

    config WELDER_BLE_ENABLED
        bool "Enable Bluetooth Control"
        default y
        help
            Enable BLE server for remote control

endmenu
```

## sdkconfig.defaults
```kconfig
# Default SDK configuration for ESP32-P4
CONFIG_IDF_TARGET="esp32p4"
CONFIG_ESP32P4_REV_MIN=0

# Enable UART
CONFIG_ESP_CONSOLE_UART_DEFAULT=y
CONFIG_ESP_CONSOLE_UART_NUM=0
CONFIG_ESP_CONSOLE_UART_BAUDRATE=115200

# ADC Configuration
CONFIG_ADC_CAL_EFUSE_LS_BIT_LEN=0
CONFIG_ADC_CAL_EFUSE_MS_BIT_LEN=0
CONFIG_ADC_CAL_VOLTAGE_REF=1100
CONFIG_ADC_CAL_LPF_COEFFICIENT=2

# LEDC (PWM) Configuration - Used for both pulse control and voltage output
CONFIG_LEDC_DEFAULT_CLK=2
CONFIG_LEDC_SUPPORT_HS_MODE=y

# Component Config
CONFIG_LWIP_SO_REUSEADDR=y
CONFIG_LWIP_SO_REUSE_RXTOALL=y

# System Config
CONFIG_ESP_TASK_WDT=y
CONFIG_ESP_TASK_WDT_TIMEOUT_S=5

# Note: ESP32-P4 does NOT support Bluetooth or DAC
# Use PWM + RC filter for analog voltage output
# BLE will be added via WiFi6 module in future firmware
```
